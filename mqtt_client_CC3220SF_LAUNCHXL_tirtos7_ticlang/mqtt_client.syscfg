/**
 * @cliArgs --board "/ti/boards/CC3220SF_LAUNCHXL" --rtos "tirtos7" --product "simplelink_cc32xx_sdk@7.10.00.13"
 * @versions {"tool":"1.18.0+3266"}
 */

/**
 * Import the modules used in this configuration.
 */
const DriverLib      = scripting.addModule("/ti/devices/DriverLib");
const Display        = scripting.addModule("/ti/display/Display");
const Display1       = Display.addInstance();
const Board          = scripting.addModule("/ti/drivers/Board");
const Crypto         = scripting.addModule("/ti/drivers/Crypto");
const Crypto1        = Crypto.addInstance();
const DMA            = scripting.addModule("/ti/drivers/DMA");
const GPIO           = scripting.addModule("/ti/drivers/GPIO");
const GPIO1          = GPIO.addInstance();
const GPIO2          = GPIO.addInstance();
const GPIO3          = GPIO.addInstance();
const GPIO4          = GPIO.addInstance();
const GPIO5          = GPIO.addInstance();
const Power          = scripting.addModule("/ti/drivers/Power");
const SPI            = scripting.addModule("/ti/drivers/SPI");
const SPI1           = SPI.addInstance();
const Timer          = scripting.addModule("/ti/drivers/Timer");
const Timer1         = Timer.addInstance();
const Timer2         = Timer.addInstance();
const Timer3         = Timer.addInstance();
const Watchdog       = scripting.addModule("/ti/drivers/Watchdog");
const Watchdog1      = Watchdog.addInstance();
const SimpleLinkWifi = scripting.addModule("/ti/drivers/net/wifi/SimpleLinkWifi");
const atcmd          = scripting.addModule("/ti/drivers/net/wifi/atcmd", {}, false);
const atcmd1         = atcmd.addInstance();
const net_utils      = scripting.addModule("/ti/drivers/net/wifi/net_utils", {}, false);
const net_utils1     = net_utils.addInstance();
const ota            = scripting.addModule("/ti/drivers/net/wifi/ota", {}, false);
const ota1           = ota.addInstance();
const MQTT           = scripting.addModule("/ti/net/MQTT", {}, false);
const MQTT1          = MQTT.addInstance();
const SNTP           = scripting.addModule("/ti/net/SNTP");
const SlNet          = scripting.addModule("/ti/net/SlNet");
const SlNet1         = SlNet.addInstance();
const Settings       = scripting.addModule("/ti/posix/tirtos/Settings");
const BIOS           = scripting.addModule("/ti/sysbios/BIOS");
const Event          = scripting.addModule("/ti/sysbios/knl/Event");
const Idle           = scripting.addModule("/ti/sysbios/knl/Idle", {}, false);
const Idle2          = Idle.addInstance();
const Mailbox        = scripting.addModule("/ti/sysbios/knl/Mailbox");
const Task           = scripting.addModule("/ti/sysbios/knl/Task");
const Error          = scripting.addModule("/ti/sysbios/runtime/Error");
const SysCallback    = scripting.addModule("/ti/sysbios/runtime/SysCallback");
const Timestamp      = scripting.addModule("/ti/sysbios/runtime/Timestamp");
const JSON           = scripting.addModule("/ti/utils/JSON");

/**
 * Write custom configuration values to the imported modules.
 */
Display1.$name                          = "CONFIG_Display_0";
Display1.$hardware                      = system.deviceData.board.components.XDS110UART;
Display1.uart.$name                     = "CONFIG_UART2_0";
Display1.uart.uart.$assign              = "UART0";
Display1.uart.uart.txPin.$assign        = "GP01";
Display1.uart.uart.txDmaChannel.$assign = "UDMA_CH9";
Display1.uart.uart.rxPin.$assign        = "GP02";
Display1.uart.uart.rxDmaChannel.$assign = "UDMA_CH8";

Crypto1.$name = "CONFIG_Crypto_0";

GPIO1.$hardware        = system.deviceData.board.components.SW2;
GPIO1.interruptTrigger = "Rising Edge";
GPIO1.$name            = "CONFIG_GPIO_BUTTON_SW2_LEFT";
GPIO1.gpioPin.$assign  = "boosterpack.3";

GPIO2.$hardware        = system.deviceData.board.components.SW3;
GPIO2.interruptTrigger = "Rising Edge";
GPIO2.$name            = "CONFIG_GPIO_BUTTON_SW3_RIGHT";
GPIO2.gpioPin.$assign  = "boosterpack.11";

GPIO3.$hardware       = system.deviceData.board.components.LED_RED;
GPIO3.outputStrength  = "High";
GPIO3.$name           = "CONFIG_GPIO_LED_RED_GPIO09";
GPIO3.gpioPin.$assign = "boosterpack.29";

GPIO4.$hardware       = system.deviceData.board.components.LED_YELLOW;
GPIO4.outputStrength  = "High";
GPIO4.$name           = "CONFIG_GPIO_LED_YELLOW_GPIO10";
GPIO4.gpioPin.$assign = "boosterpack.9";

GPIO5.$hardware       = system.deviceData.board.components.LED_GREEN;
GPIO5.outputStrength  = "High";
GPIO5.$name           = "CONFIG_GPIO_LED_GREEN_GPIO11";
GPIO5.gpioPin.$assign = "boosterpack.10";

Power.ioRetentionShutdown = ["GRP_1"];
Power.parkPins.$name      = "ti_drivers_power_PowerCC32XXPins0";

SPI1.$name                    = "CONFIG_SPI_0";
SPI1.mode                     = "Four Pin CS Active Low";
SPI1.defaultTxBufferValue     = "0";
SPI1.spi.$assign              = "SPI0";
SPI1.spi.sclkPin.$assign      = "boosterpack.7";
SPI1.spi.pociPin.$assign      = "boosterpack.14";
SPI1.spi.picoPin.$assign      = "boosterpack.15";
SPI1.spi.dmaRxChannel.$assign = "UDMA_CH6";
SPI1.spi.dmaTxChannel.$assign = "UDMA_CH7";
SPI1.spi.csnPin.$assign       = "boosterpack.18";

Timer1.$name         = "CONFIG_TIMER_0";
Timer1.timerType     = "32 Bits";
Timer1.timer.$assign = "Timer0";

Timer2.$name         = "CONFIG_TIMER_1";
Timer2.timer.$assign = "Timer1";

Timer3.$name         = "CONFIG_TIMER_2";
Timer3.timer.$assign = "Timer1";

Watchdog1.$name            = "CONFIG_WATCHDOG_0";
Watchdog1.watchdog.$assign = "WATCHDOG0";

atcmd1.$name = "CONFIG_ATCMD_0";

net_utils1.$name = "CONFIG_NET_UTILS_0";

ota1.$name = "CONFIG_OTALib_0";

MQTT1.$name = "CONFIG_MQTT_0";

SlNet1.$name  = "CONFIG_SLNET";
SlNet1.ifName = "CC32xx";

BIOS.assertsEnabled = false;
BIOS.heapBaseAddr   = "__primary_heap_start__";
BIOS.heapEndAddr    = "__primary_heap_end__";

const Hwi           = scripting.addModule("/ti/sysbios/family/arm/m3/Hwi", {}, false);
Hwi.enableException = false;

Idle2.$name   = "powerIdle";
Idle2.idleFxn = "Power_idleFunc";

const Semaphore            = scripting.addModule("/ti/sysbios/knl/Semaphore", {}, false);
Semaphore.supportsPriority = false;

Task.checkStackFlag   = false;
Task.defaultStackSize = 4096;

Error.policy       = "Error_SPIN";
Error.printDetails = false;

const System           = scripting.addModule("/ti/sysbios/runtime/System", {}, false);
System.abortFxn        = "System_abortSpin";
System.exitFxn         = "System_exitSpin";
System.extendedFormats = "%f";
System.supportModule   = "SysCallback";
